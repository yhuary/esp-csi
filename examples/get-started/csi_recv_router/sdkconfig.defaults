## examples/get-started/csi_recv_router/sdkconfig.defaults
```kconfig
#
# Wi-Fi
#
CONFIG_ESP_WIFI_CSI_ENABLED=y
CONFIG_ESP_WIFI_AMPDU_TX_ENABLED=n
CONFIG_ESP_WIFI_AMPDU_RX_ENABLED=n
CONFIG_ESP_WIFI_DYNAMIC_RX_BUFFER_NUM=128
CONFIG_ESP_WIFI_DYNAMIC_TX_BUFFER_NUM=32

#
# UART 
#
CONFIG_ESP_CONSOLE_UART_CUSTOM=y
CONFIG_ESP_CONSOLE_UART=y
CONFIG_ESP_CONSOLE_UART_NUM=0
CONFIG_ESP_CONSOLE_UART_BAUDRATE=921600

CONFIG_ESP_TASK_WDT_TIMEOUT_S=30

CONFIG_ESPTOOLPY_MONITOR_BAUD=921600

#
# Compiler options
#
CONFIG_COMPILER_OPTIMIZATION_PERF=y

#
# FreeRTOS
#
CONFIG_FREERTOS_HZ=1000
```
